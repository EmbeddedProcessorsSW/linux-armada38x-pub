## drivers/net/ethernet/cavium/Kconfig
```kconfig
# SPDX-License-Identifier: GPL-2.0-only
#
# Cavium ethernet device configuration
#

config NET_VENDOR_CAVIUM
	bool "Cavium ethernet drivers"
	default y
	help
	  Select this option if you want enable Cavium network support.

	  If you have a Cavium SoC or network adapter, say Y.

if NET_VENDOR_CAVIUM

config THUNDER_NIC_PF
	tristate "Thunder Physical function driver"
	depends on 64BIT && PCI
	select THUNDER_NIC_BGX
	help
	  This driver supports Thunder's NIC physical function.
	  The NIC provides the controller and DMA engines to
	  move network traffic to/from the memory. The NIC
	  works closely with TNS, BGX and SerDes to implement the
	  functions replacing and virtualizing those of a typical
	  standalone PCIe NIC chip.

config THUNDER_NIC_VF
	tristate "Thunder Virtual function driver"
	imply CAVIUM_PTP
	depends on 64BIT && PCI
	help
	  This driver supports Thunder's NIC virtual function

config	THUNDER_NIC_BGX
	tristate "Thunder MAC interface driver (BGX)"
	depends on 64BIT && PCI
	select PHYLIB
	select MDIO_THUNDER if PCI
	select THUNDER_NIC_RGX
	help
	  This driver supports programming and controlling of MAC
	  interface from NIC physical function driver.

config	THUNDER_NIC_RGX
	tristate "Thunder MAC interface driver (RGX)"
	depends on 64BIT && PCI
	select PHYLIB
	select MDIO_THUNDER if PCI
	help
	  This driver supports configuring XCV block of RGX interface
	  present on CN81XX chip.

config CAVIUM_PTP
	tristate "Cavium PTP coprocessor as PTP clock"
	depends on 64BIT && PCI
	depends on PTP_1588_CLOCK
	help
	  This driver adds support for the Precision Time Protocol Clocks and
	  Timestamping coprocessor (PTP) found on Cavium processors.
	  PTP provides timestamping mechanism that is suitable for use in IEEE 1588
	  Precision Time Protocol or other purposes.  Timestamps can be used in
	  BGX, TNS, GTI, and NIC blocks.

config LIQUIDIO
	tristate "Cavium LiquidIO support"
	depends on 64BIT && PCI
	depends on PCI
	depends on PTP_1588_CLOCK_OPTIONAL
	select FW_LOADER
	select LIBCRC32C
	select NET_DEVLINK
	help
	  This driver supports Cavium LiquidIO Intelligent Server Adapters
	  based on CN66XX, CN68XX and CN23XX chips.

	  To compile this driver as a module, choose M here: the module
	  will be called liquidio.  This is recommended.

config OCTEON_MGMT_ETHERNET
	tristate "Octeon Management port ethernet driver (CN5XXX, CN6XXX)"
	depends on CAVIUM_OCTEON_SOC
	select PHYLIB
	select MDIO_OCTEON
	default y
	help
	  Enable the ethernet driver for the management
	  port on Cavium Networks' Octeon CN57XX, CN56XX, CN55XX,
	  CN54XX, CN52XX, and CN6XXX chips.

config LIQUIDIO_VF
	tristate "Cavium LiquidIO VF support"
	depends on 64BIT && PCI_MSI
	depends on PTP_1588_CLOCK_OPTIONAL
	help
	  This driver supports Cavium LiquidIO Intelligent Server Adapter
	  based on CN23XX chips.

	  To compile this driver as a module, choose M here: The module
	  will be called liquidio_vf. MSI-X interrupt support is required
	  for this driver to work correctly

config OCTEONTX_FPA_PF
	tristate "OcteonTX free pool allocator physical function driver(FPA_PF)"
	depends on 64BIT && PCI
	default y
	help
	  Select this option to enable FPA Physical function.
	  FPA provides hardware assisted memory management for
	  OcteonTX coprocessors.

	  To compile this as a module, choose M here.

config OCTEONTX_FPA_VF
	tristate "OcteonTX free pool allocator virtual function driver(FPA_VF)"
	depends on 64BIT && PCI
	default y
	help
	  Select this option to enable FPA Virtual function.
	  FPA provides hardware assisted memory management for
	  OcteonTX coprocessors. Each VF owns single FPA pool.

	  To compile this as a module, choose M here.

config OCTEONTX_RST
	tristate "OcteonTX Reset driver(RST)"
	depends on 64BIT && PCI
	default y
	help
	  Select this option to enable RST.
	  OcteonTX Reset unit controls the CN83XX chip reset.

	  To compile this as a module, choose M here.

config OCTEONTX_SSO_PF
	tristate "OcteonTX SSO physical function driver(SSO_PF)"
	depends on 64BIT && PCI && OCTEONTX_FPA_PF && OCTEONTX_FPA_VF && OCTEONTX_RST
	default y
	help
	  Select this option to enable SSO Physical function.
	  SSO is a way to submit work from Cores.

	  To compile this as a module, choose M here.

config OCTEONTX_SSOW_PF
	tristate "OcteonTX SSOW physical function driver(SSOW_PF)"
	depends on 64BIT && PCI && OCTEONTX_SSO_PF
	default y
	help
	  Select this option to enable SSOW Physical function.
	  SSOW is a way to get work for cores.

	  To compile this as a module, choose M here.

config OCTEONTX_PKO_PF
	tristate "OcteonTX PKO physical function driver(PKO_PF)"
	depends on 64BIT && PCI && OCTEONTX_FPA_PF && OCTEONTX_FPA_VF
	default y
	help
	  Select this option to enable PKO Physical function.
	  PKO block is responsible for packet transmission.

	  To compile this as a module, choose M here.

config OCTEONTX_LBK
	tristate "OcteonTX Loopback Interface driver(LBK)"
	depends on 64BIT && PCI
	default y
	help
	  Select this option to enable LBK.
	  OcteonTX Loopback Interface

	  To compile this as a module, choose M here.

config OCTEONTX_TIM_PF
	tristate "OcteonTX TIM physical function driver(TIM_PF)"
	depends on 64BIT && PCI && OCTEONTX_RST
	default y
	help
	  Select this option to enable TIM Physical function.
	  Timer hw block (TIM) enables software to schedule SSO
	  work-queue entries for a future time.

	  To compile this as a module, choose M here.

config OCTEONTX_PKI
	tristate "OcteonTX Input packet parser(PKI)"
	depends on 64BIT && PCI
	default y
	help
	  Select this option to enable PKI.
	  PKI parses input packets and create work.

	  To compile this as a module, choose M here.

config OCTEONTX_DPI
	tristate "OcteonTX DMA Packet Interface(DPI)"
	depends on 64BIT && PCI
	default y
	help
	  Select this option to enable DPI.
	  DPI (DMA packet interface) provides DMA support for MAC.
	  It transfers data between onchip IO bus and SLI.
	  SLI interfaces PEM(PCIe) blocks.

	  To compile this as a module, choose M here.

config OCTEONTX_SLI_PF
	tristate "OcteonTX SLI physical function driver(SLI_PF)"
	depends on 64BIT && PCI && OCTEONTX_DPI && OCTEONTX_RST
	default y
	help
	  Select this option to enable SLI.
	  SLI interfaces PEM(PCIe) blocks to the cores and memory.
          SLI needs to be configured when OcteonTX is connected
          in EP mode to a host.

	  To compile this as a module, choose M here.

config OCTEONTX
	tristate "OcteonTX coprocessor maintainer"
	depends on THUNDER_NIC_BGX && OCTEONTX_FPA_PF && OCTEONTX_SSO_PF
	depends on OCTEONTX_PKO_PF && OCTEONTX_SSOW_PF && OCTEONTX_PKI
	depends on OCTEONTX_DPI && OCTEONTX_LBK && OCTEONTX_TIM_PF
	depends on OCTEONTX_SLI_PF
	default y
	help
	  Select this option to enable Octeon coprocessor management.

	  To compile this as a module, choose M here.

endif # NET_VENDOR_CAVIUM
```

## drivers/soc/marvell/Kconfig
```kconfig
#
# MARVELL SoC drivers
#

menu "Marvell SoC drivers"

config OCTEONTX2_SDP_PF
	tristate "OcteonTX2 SDP PF driver"
	depends on ARM64 && PCI && OCTEONTX2_AF && OCTEONTX2_MBOX
	default y
	help
	  This driver configures the SDP RVU PF when OcteonTx is in PCIe EndPoint
	  mode. It sets up the SDP rings  and the VFs to be used in packet transfer
	  using the NIX block.

	  To compile this as a module choose M here.

config OCTEONTX2_DPI_PF
	tristate "OcteonTX2 DPI-DMA PF driver"
	depends on ARM64 && PCI
	default m
	help
	  Select this option to enable DPI PF driver support.
	  DPI (DMA packet interface) provides DMA support for MAC.
	  This driver intializes DPI PF device and enables VFs for supporting
	  different types of DMA transfers.

config GTI_WATCHDOG
	tristate "GTI Watchdog driver"
	depends on ARM64
	help
	  GTI Watchdog driver, provides ioctl's for applications to
	  setup and enable the NMI Watchdog and also provides
	  an mmap() interface to map GTI device memory into process
	  address space for the application to directly poke the
	  GTI watchdog without any kernel support and entry.

config HW_CSR_ACCESS
	tristate "Access HW Device Config Space"
	depends on OCTEONTX2_AF
	default m
	help
 	  provides an interface which enables user space utility to read from or to write
	  to HW Device Config Space Registers, Contexts, Memory.

config OCTEONTX_SERDES
	tristate "OcteonTX2 serdes debug commands"
	default m
	depends on ARM64 && HAVE_ARM_SMCCC && DEBUG_FS
	help
	  Provides debugfs commands which allows to collect serdes information,
	  capture eye, use PRBS, configure serdes in loopback mode, and
	  read/write TX tuning parameters.

config MARVELL_FWLOG
	tristate "firmware log interface"
	depends on ARM64
	help
	  Provides interface to read firmware boot logs. Firmware bootlogs are saved
	  in memory that is accessible from kernel. Enabling this option allows the
	  user to dump the firmware boot logs.

	  Firmware needs to build with `RECORD_FWLOG=1` to see the boot logs and
	  U-boot config `CONFIG_FWLOG_TTYMEM` is also required to have this feature
	  validated from linux.

	  Say Y here if you want to dump the firmware boot logs from linux shell. This
	  option is available only for Octeon10 and OcteonTX2 platforms.

config MVMDIO_UIO
	tristate "Marvell MDIO interface driver"
	  default m
	select MDIO_THUNDER
	help
	  Select this option if you want to provide an interface for userspace
	  PHY drivers to access Marvell's MDIO bus.

config MARVELL_CN10K_SERDES_DIAGNOSTICS
	tristate "Marvell SerDes diagnostics debugfs driver"
	default m
	depends on DEBUG_FS
	help
	  Select this option if you want to enable SerDes diagnostics
	  interface for performing PRBS, setting Loopback mode or
	  reading/writing Tx/Rx tuning parameters.

config MRVL_PHY_DIAGNOSTICS
	tristate "Marvell PHY diagnostics debugfs driver"
	default m
	depends on DEBUG_FS
	help
	  Select this option if you want an additional interface for
	  extended diagnostics functions for the PHY. This complements
	  functionality offered by ethtool. Requires PHY driver support in ATF.

config OCTEONTX_INFO
       tristate "OcteonTX Info driver"
	depends on PROC_FS
	help
	provides procfs interface to board information like board name, board revision
	mac addresses, board serial number and more. These are boards housing Marvell
	OcteonTX family chipsets.

config MRVL_SWUP
        tristate "Marvell firmware secure update"
        depends on ARM64
        help
          Provide debugfs interface for firmware update.
          Supported on cnXX family.
          Currently supported operations:
            -> TIM Version check
            -> TIM Hash verification
            -> TIM firmware update

config MARVELL_PTM_EP
	tristate "Marvell PCIe PTM EP"
	default m
	help
	  Provides PTM requestor(EP) support. The driver provides interface for
	  triggering and capturing time.

	  To compile this as a module, choose M here. The module will be called
	  mrvl-ptm-ep.

endmenu
```
