## Documentation/devicetree/bindings/arm/marvell/cn9130-musdk-cma.yaml
```yaml
# SPDX-License-Identifier: (GPL-2.0-only OR BSD-2-Clause)
%YAML 1.2

title: Marvell MUSDK continuous memory allocation driver (BM)

properties:
  compatible: should be "marvell,musdk-cma".

Optional properties:
  dma-coherent

examples:
  - |
    musdk_cma {
	compatible = "marvell,musdk-cma";
	dma-coherent;
    };
```

## Documentation/devicetree/bindings/arm/marvell/cn9130-pci-console-nexus.yaml
```yaml
# SPDX-License-Identifier: (GPL-2.0-only OR BSD-2-Clause)
%YAML 1.2

title: Marvell pci console memory reservation.

properties:
  compatible: should be "marvell,pci-console-nexus-memory"
  reg: reg address

examples:
  - |
    reserved-memory {
		#address-cells = <2>;
		#size-cells = <2>;
		ranges;

		/* The PCI console memory must be reserved */
		console_reserved: pci-console-nexus@3f000000 {
			compatible = "marvell,pci-console-nexus-memory";
			reg = <0 0x3f000000 0 0x1000000>;
			no-map;
		};
	};

	cp0 {
		/delete-node/ pcie@600000;
		/delete-node/ pcie@620000;
		/delete-node/ pcie@640000;
	};
};
```

## Documentation/devicetree/bindings/arm/marvell/cn9130-uio-sam.yaml
```yaml
# SPDX-License-Identifier: (GPL-2.0-only OR BSD-2-Clause)
%YAML 1.2

title: Marvell UIO for Security Acceleration Module (SAM)

properties:
  compatible: should be "marvell,uio-sam".
  eip_access: phandler to EIP crypto driver

example:
  - |
    CP110_LABEL(uio_sam): uio_sam@800000 {
	compatible = "marvell,uio-sam";
	eip_access = <&CP110_LABEL(crypto)>;
    };
```

## Documentation/devicetree/bindings/arm/marvell/cn9130-uio-xor.yaml
```yaml
# SPDX-License-Identifier: (GPL-2.0-only OR BSD-2-Clause)
%YAML 1.2

title: Marvell UIO for XOR driver

properties:
  compatible: should be "marvell,uio-xor-v2".
  xor_access: phandler to XOR driver

examples:
  - |
    P110_LABEL(uio_xor1) {
	compatible = "marvell,uio-xor-v2";
	xor_access = <&CP110_LABEL(xor1)>;
    };
```

## Documentation/devicetree/bindings/edac/marvell,sdei-ghes.yaml
```yaml
# SPDX-License-Identifier: GPL-2.0-only OR BSD-2-Clause
%YAML 1.2
---
$id: http://devicetree.org/schemas/edac/marvell,sdei-ghes.yaml#
$schema: http://devicetree.org/meta-schemas/core.yaml#

title: Marvell EDAC driver

description: |
  This driver uses the EDAC framework to implement the
  Marvell OcteonTX2/CN10K (CN10K) SoC EDAC driver.
  Counts and corrects single-bit errors and counts
  double-bit errors, which are uncorrectable.
  Driver handle SECDED notification from SDEI call
  after firmware first GHES interrupt handling.

  Marvell OcteonTX2/CN10K SOC sdei-ghes node
  It is defined to describe GHES resources for SECDED.

  The following error sources are supported:

  MDC     - OcteonTX2/CN10K Memory Diagnostic Controller
  MCC     - OcteonTX2 Memory Common Controller
  DSS     - CN10K DDR5 Memory Controller
  TAD     - CN10K Cache Memory Controller
  CORE[i] - CN10K ARM core processors

properties:

  compatible:
    const: marvell,sdei-ghes

  reg:
    maxItems: 3

  "#address-cells":
    const: 2

  "#size-cells":
    const: 1

  event-id:
    description: SDEI event ID for receiving firmware notifications

required:
  - compatible
  - reg
  - "#address-cells"
  - "#size-cells"
  - event-id

examples:
  - |
    sdei-ghes {
        compatible = "marvell,sdei-ghes";
        #address-cells = <2>;
        #size-cells = <1>;
        memory-region = <&ghes_hest_reserved>;
        /*
         * Range placeholders; the addrs are set dynamically by
         * firmware to match 'reg' in 'ghes_hest_reserved'.
         */
        ranges = <0x0 0x00000000 0x0 0x0 0x00100>,
                 <0x0 0x00000100 0x0 0x0 0x00700>,
                 <0x0 0x00000800 0x0 0x0 0x08000>;
        mdc {
                reg = <0x0 0x00000000 0x008>,
                      <0x0 0x00000100 0x9D>,
                      <0x0 0x00000800 0x800>;
                event-id = <0x40000000>;
        };
        mcc {
                reg = <0x0 0x00000008 0x008>,
                      <0x0 0x00000200 0x9D>,
                      <0x0 0x00001000 0x800>;
                event-id = <0x40000001>;
        };
        lmc {
                reg = <0x0 0x00000010 0x008>,
                      <0x0 0x00000300 0x9D>,
                      <0x0 0x00001800 0x800>;
                event-id = <0x40000002>;
        };
    };
```

## Documentation/devicetree/bindings/mailbox/marvell,mhu.yaml
```yaml
# SPDX-License-Identifier: GPL-2.0-only or BSD-2-Clause
%YAML 1.2
---
$id: http://devicetree.org/schemas/mailbox/marvell,mhu.yaml#
$schema: http://devicetree.org/meta-schemas/core.yaml#

title: Marvell Message Handling Unit

maintainers:
  - Sujeet Baranwal <sbaranwal@marvell.com>
  - Wojciech Bartczak <wbartczak@marvell.com>

description:
  The Control-Processors Cluster (CPC) provides Arm-platform specification
  entities for managing the system. One of the CPC processors is the System
  Control Processor (SCP). The SCP is responsible, among others, for booting
  the chip, clock and power initialization, controlling power consumption
  through DVFS, monitoring temperature sensors and controlling AVS. The SCP,
  as each XCP, contains mailboxes for software-to-software communications.
  Mailbox writes cause an interrupt to the local XCP core or to the AP.
  This driver exposes AP-SCP Message Handling Unit to the system, providing
  the mailbox communication mechanism to the system, with the intention
  of plugging into the SCMI framework. It is designed to work with Marvell
  OcteonTX and OcteonTX2-based platforms.
  Mailbox has no other usage than SCMI communication. In case of
  configurations running without SCMI support it should be disabled.

properties:
  compatible:
    oneOf:
      - items:
          - enum:
              - marvell,mbox

  reg:
    maxItems: 1

  "#mbox-cells":
    description: Index of the channel
    const: 1

required:
  - compatible
  - reg
  - "#mbox-cells"

additionalProperties: false

examples:
  - |
    ecam {
        #address-cells = <3>;
        #size-cells = <2>;
            mailbox: mailbox@1c,0 {
                compatible = "marvell,mbox";
                reg = <0xe000 0x0 0x0 0 0>;
                #mbox-cells = <1>;
            };
    };
```

## Documentation/devicetree/bindings/soc/marvell/marvell,bert.yaml
```yaml
# SPDX-License-Identifier: GPL-2.0-only OR BSD-2-Clause
%YAML 1.2

title: Marvell BERT driver

description: |
  bert driver for CN9x SoC for RAS fatal
  error report via preserved memory region

properties:

  compatible:
    const: marvell,bed-bert

  reg:
    maxItems: 3

  "#address-cells":
    const: 2

  "#size-cells":
    const: 2

examples:
  - |
    bed-bert {
       compatible = "marvell,bed-bert";
       #address-cells = <2>;
       #size-cells = <2>;
       memory-region = <&ghes_bert_reserved>;
       /*
        * Range placeholders; these are set dynamically by
        * firmware to match 'reg' in 'ghes_bert_reserved'.
        */
       ranges = <0x0 0x0 0x0 0x0 0x0 0x0>,
                <0x0 0x0 0x0 0x0 0x0 0x0>,
                <0x0 0x0 0x0 0x0 0x0 0x0>;
       bert {
             reg = <0x0 0x00000000 0x0 0x600>,
                   <0x0 0x00000600 0x0 0x100>,
                   <0x0 0x00000700 0x0 0x300>;
            };
    };
```

## drivers/firmware/octeontx2/Kconfig
```kconfig
# SPDX-License-Identifier: GPL-2.0
#
# Marvell Utility Bus for firmware
#

menuconfig MARVELL_UB
	bool "Marvell Utility Bus"
	default n
	depends on ARM64 && SYSFS
	help
	  Marvell Utility Bus provides set of drivers allowing communication
	  with various services provided by firmware for OcteonTX2
	  based platforms.
	  These drivers are useful only for Marvell CN9X and CN10X SoCs.
	  If unsure, say N here.

if MARVELL_UB

config MARVELL_UB_GEN_DRIVER
	tristate "Generic driver for OcteonTX2 & CN10K platforms"
	default y
	depends on MARVELL_UB && HAVE_ARM_SMCCC
	help
	  The generic driver provides a generic implementation of
	  platform detection and firmware services.
	  By default the drvier handles CN9X and CN10X platforms.
	  If unsure, say Y here.

config MARVELL_PORTM_BOOT_CFG
	bool "Marvell PORTM boot mode configuration interface"
	depends on HAVE_ARM_SMCCC
	select MARVELL_UB_GEN_DRIVER
	default n
	help
	  Enable sysfs interface for PORTM mode configuration
	  that will be effective from the next boot.
	  Currently, only cn10k platforms are supported.
	  If unsure, say N here.

config MARVELL_RETIMER_MGMT
	bool "Marvell Retimer mgmt interface"
	depends on HAVE_ARM_SMCCC
	select MARVELL_UB_GEN_DRIVER
	default n
	help
	  Enable sysfs interface providing basic control
	  over Retimer device for cnf10kb platform.
	  Each of the four devices will expose simple
	  interface for setting GSERM index that is to be
	  routed through the MUX and the ethernet mode -
	  - both effective from the next boot.
	  Currently, works only with cn10k platforms
	  If unsure, say N here.

config MARVELL_CN10K_RPRAM
	tristate "Octeontx RPRAM configuration interface"
	depends on HAVE_ARM_SMCCC
	select MARVELL_UB_GEN_DRIVER
	default n
	help
	  The module enables configuration interface for the persistent data
	  memory region. The interface allows to control the size of the region.
	  The new value is used after platform reboot.
	  Only Octeon 10x platform are supported by this module.
	  If unsure, say N here.

config MARVELL_MEMTEST
	tristate "Memory POST configuration utility"
	depends on HAVE_ARM_SMCCC
	select MARVELL_UB_GEN_DRIVER
	default n
	help
	  This option enables a module that provides sysfs entries to manipulate
	  configuration of the power-on self test for memory executed
	  at warm and cold boot.
	  If unsure, say N here.

config MARVELL_CN10K_MAC_MGMT
	tristate "CN10K MAC management interface"
	default n
	depends on HAVE_ARM_SMCCC
	select MARVELL_UB_GEN_DRIVER
	help
	  The module provides an interface to change MAC addresses assigned
	  to the network devices.
	  Driver is supported only for CN10K platform.
	  If unsure, say N here.

endif # MARVELL_UB
```
