// SPDX-License-Identifier: GPL-2.0
/*
 * Copyright (C) 2023 Marvell
 *
 * Device tree for the CN9130-CRB-A board.
 */

#include "cn9130-crb.dtsi"
/ {
	model = "Marvell Armada CN9130-CRB-A";
};


&cp0_pcie0 {
	status = "okay";
	num-lanes = <4>;
	num-viewport = <8>;
	/* Generic PHY, providing serdes lanes */
	phys = <&cp0_comphy0 0
		&cp0_comphy1 0
		&cp0_comphy2 0
		&cp0_comphy3 0>;
	iommu-map =
		<0x0   &smmu 0x480 0x20>,
		<0x100 &smmu 0x4a0 0x20>,
		<0x200 &smmu 0x4c0 0x20>;
		iommu-map-mask = <0x031f>;
};
